/*@!Encoding:1252*/
variables
{
  Timer blinkTimer;
}

on timer blinkTimer
{
  if(getValue(BlinkerL_pushbutton)==1)
  {
    putValue(BlinkerL_value,getValue(BlinkerL_value)+1);
  }
}

